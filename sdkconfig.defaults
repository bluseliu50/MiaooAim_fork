## sdkconfig.defaults
```kconfig
# Keep logs readable during bring-up
CONFIG_IDF_TARGET="esp32s3"
CONFIG_IDF_TARGET_ESP32S3=y

CONFIG_LOG_DEFAULT_LEVEL_INFO=y
CONFIG_ESP_MAIN_TASK_STACK_SIZE=8192

# Code size: factory partition headroom is tight (~8.8%). Optimize for size (-Os)
# instead of the default debug level (-Og) to free flash for OTA growth.
CONFIG_COMPILER_OPTIMIZATION_SIZE=y

# Use custom partition table with SPIFFS
CONFIG_PARTITION_TABLE_CUSTOM=y
CONFIG_PARTITION_TABLE_FILENAME="partitions.csv"
CONFIG_PARTITION_TABLE_OFFSET=0x8000

# OTA safety: boot the new app once in pending-verify state and roll back if it fails.
CONFIG_BOOTLOADER_APP_ROLLBACK_ENABLE=y

# Flash size (your chip is 16MB)
CONFIG_ESPTOOLPY_FLASHSIZE_16MB=y
CONFIG_ESPTOOLPY_FLASHSIZE="16MB"

# ESP32-S3 boards used by this project usually include PSRAM. 5.83"/7.5"
# tricolor image conversion needs it because two EPD planes are too large
# for the remaining internal heap after Wi-Fi/Web startup.
CONFIG_SPIRAM=y
CONFIG_ESP32S3_SPIRAM_SUPPORT=y
CONFIG_SPIRAM_MODE_OCT=y
CONFIG_SPIRAM_SPEED_80M=y
CONFIG_SPIRAM_IGNORE_NOTFOUND=y
CONFIG_SPIRAM_USE_MALLOC=y
CONFIG_SPIRAM_MALLOC_RESERVE_INTERNAL=65536

# Enable SPIFFS (we mount /spiffs)
CONFIG_SPIFFS_MAX_PARTITIONS=2

# Crash diagnostics: keep panic/watchdog core dumps in the flash coredump
# partition. This is the ESP-IDF standard "system safety log" mechanism and is
# useful when field devices reboot after WDT/panic.
CONFIG_ESP_COREDUMP_ENABLE_TO_FLASH=y
# CONFIG_ESP_COREDUMP_ENABLE_TO_UART is not set
# CONFIG_ESP_COREDUMP_ENABLE_TO_NONE is not set
CONFIG_ESP_COREDUMP_DATA_FORMAT_BIN=y
# CONFIG_ESP_COREDUMP_DATA_FORMAT_ELF is not set
CONFIG_ESP_COREDUMP_CHECKSUM_CRC32=y
# CONFIG_ESP_COREDUMP_CHECKSUM_SHA256 is not set
CONFIG_ESP_COREDUMP_CHECK_BOOT=y
CONFIG_ESP_COREDUMP_MAX_TASKS_NUM=8
CONFIG_ESP_COREDUMP_USE_STACK_SIZE=y
CONFIG_ESP_COREDUMP_STACK_SIZE=2048

# HTTP server
CONFIG_HTTPD_MAX_REQ_HDR_LEN=1024
CONFIG_HTTPD_MAX_URI_LEN=512

# HTTPS (for weather API)
# Use the "common" root-CA subset instead of the FULL bundle to save ~30KB flash.
# QWeather's API host uses mainstream commercial CAs (DigiCert / GlobalSign /
# Let's Encrypt …) which are covered by CMN. If weather HTTPS ever fails to
# validate (boot log loses "esp-x509-crt-bundle: Certificate validated"),
# revert this single line back to ..._DEFAULT_FULL=y.
CONFIG_MBEDTLS_CERTIFICATE_BUNDLE=y
CONFIG_MBEDTLS_CERTIFICATE_BUNDLE_DEFAULT_CMN=y

# lwIP: STA+SoftAP + HTTPD + esp_http_client can hit pbuf ref asserts in tcp_input under load.
CONFIG_LWIP_TCPIP_TASK_STACK_SIZE=8192
# TCPIP_CORE_LOCKING is off: on ESP32-S3 SMP it can destabilize the scheduler (Core 1 panic in prvSelectHighestPriorityTaskSMP).
# CONFIG_LWIP_TCPIP_CORE_LOCKING is not set
# CONFIG_LWIP_TCPIP_TASK_AFFINITY_NO_AFFINITY is not set
CONFIG_LWIP_TCPIP_TASK_AFFINITY_CPU0=y
# Simpler TCP RX path (fewer tcp_seg/pbuf edges in tcp_free_acked_segments)
# CONFIG_LWIP_TCP_QUEUE_OOSEQ is not set
```
